#include "pp16_config.h"
#include "platform_io_signals.h"

void RCC_Config(void){

		int StartUpCounter = 0;

		SystemInit();

		RCC->CR |= RCC_CR_HSEON;
	
		while(!(RCC->CR & RCC_CR_HSERDY) && (StartUpCounter != 0xFFFF)){
			StartUpCounter++;
		};
	
		if(RCC->CR & RCC_CR_HSERDY){
			RCC->APB1ENR1 |= RCC_APB1ENR1_PWREN;

			RCC->CR&=~RCC_CR_PLLON;
			while(RCC->CR & RCC_CR_PLLRDY);
			RCC->PLLCFGR=(RCC->PLLCFGR & ~RCC_PLLCFGR_PLLSRC) | RCC_PLLCFGR_PLLSRC_HSE;
			
			RCC->PLLCFGR=(RCC->PLLCFGR & ~RCC_PLLCFGR_PLLM) | RCC_PLLCFGR_PLLM_DIV2;
			RCC->PLLCFGR=(RCC->PLLCFGR & ~RCC_PLLCFGR_PLLN) | RCC_PLLCFGR_PLLN_MUL40;
			RCC->PLLCFGR=(RCC->PLLCFGR & ~RCC_PLLCFGR_PLLR) | RCC_PLLCFGR_PLLR_DIV2;
			RCC->PLLCFGR|=RCC_PLLCFGR_PLLREN;
			
			RCC->CR|=RCC_CR_PLLON;
			while(!(RCC->CR & RCC_CR_PLLRDY)) 
				;   
			
			FLASH->ACR = FLASH_ACR_PRFTEN | FLASH_ACR_ICEN | FLASH_ACR_DCEN | FLASH_ACR_LATENCY_5WS;

			RCC->CFGR=(RCC->CFGR & ~RCC_CFGR_SW) | RCC_CFGR_SW_PLL;
			RCC->CFGR |= RCC_CFGR_HPRE_DIV1;
			RCC->CFGR |= RCC_CFGR_PPRE2_DIV1;
			RCC->CFGR |= RCC_CFGR_PPRE1_DIV1;

			/* Wait till the main PLL is used as system clock source */
			while ((RCC->CFGR & (uint32_t)RCC_CFGR_SWS ) != RCC_CFGR_SWS_PLL)
				;
				
			
		}else{
			RCC->CR |= RCC_CR_HSION;
			
			while(!(RCC->CR & RCC_CR_HSIRDY)) 
			;
			
			RCC->APB1ENR1 |= RCC_APB1ENR1_PWREN;

			RCC->CR&=~RCC_CR_PLLON;
			while(RCC->CR & RCC_CR_PLLRDY);
			RCC->PLLCFGR&=~RCC_PLLCFGR_PLLSRC;
			RCC->PLLCFGR=(RCC->PLLCFGR & ~RCC_PLLCFGR_PLLM) | RCC_PLLCFGR_PLLM_DIV2;
			RCC->PLLCFGR=(RCC->PLLCFGR & ~RCC_PLLCFGR_PLLN) | RCC_PLLCFGR_PLLN_MUL30;
			RCC->PLLCFGR=(RCC->PLLCFGR & ~RCC_PLLCFGR_PLLR) | RCC_PLLCFGR_PLLR_DIV2;
			RCC->PLLCFGR|=RCC_PLLCFGR_PLLREN;
			RCC->CR|=RCC_CR_PLLON;
			while(!(RCC->CR & RCC_CR_PLLRDY)) 
				;  

			FLASH->ACR = FLASH_ACR_PRFTEN | FLASH_ACR_ICEN | FLASH_ACR_DCEN | FLASH_ACR_LATENCY_5WS;

			RCC->CFGR=(RCC->CFGR & ~RCC_CFGR_SW) | RCC_CFGR_SW_PLL;
			RCC->CFGR |= RCC_CFGR_HPRE_DIV1;
			RCC->CFGR |= RCC_CFGR_PPRE2_DIV1;
			RCC->CFGR |= RCC_CFGR_PPRE1_DIV1;

			/* Wait till the main PLL is used as system clock source */
			while ((RCC->CFGR & (uint32_t)RCC_CFGR_SWS ) != RCC_CFGR_SWS_PLL);
		}
  
		RCC->CRRCR|=RCC_CRRCR_HSI48ON;
		while(!(RCC->CRRCR & RCC_CRRCR_HSI48RDY)) 
				;  
		RCC->CCIPR=(RCC->CCIPR & ~RCC_CCIPR_CLK48SEL);	
		
		SystemCoreClockUpdate();


		RCC->AHB3ENR |= RCC_AHB3ENR_OSPI1EN;
		
		RCC->AHB2ENR |= RCC_AHB2ENR_GPIOAEN;
		RCC->AHB2ENR |= RCC_AHB2ENR_GPIOBEN;
		RCC->AHB2ENR |= RCC_AHB2ENR_GPIOCEN;
		RCC->AHB2ENR |= RCC_AHB2ENR_GPIODEN;	
		RCC->AHB2ENR |= RCC_AHB2ENR_GPIOEEN;	
		RCC->AHB2ENR |= RCC_AHB2ENR_GPIOFEN;		
		RCC->AHB2ENR |= RCC_AHB2ENR_GPIOGEN;	

		RCC->APB1ENR1|=RCC_APB1ENR1_TIM5EN;
		RCC->APB1ENR1|=RCC_APB1ENR1_PWREN;

		RCC->APB2ENR|=RCC_APB2ENR_TIM8EN;
		RCC->APB2ENR|= RCC_APB2ENR_SYSCFGEN;
		
		PWR->CR2|=PWR_CR2_IOSV;	//switch on PG[15:2]

}


void NVIC_Config(void){
		#define DRIVE_TIM_PRIO	7

		NVIC_SetPriorityGrouping(NVIC_PriGroup_4);
	
	
		NVIC_SetPriority(OCTOSPI1_IRQn, 1); 
		NVIC_EnableIRQ(OCTOSPI1_IRQn);
		
		NVIC_SetPriority(TIM5_IRQn, 2);
		NVIC_EnableIRQ(TIM5_IRQn);
		
		NVIC_SetPriority(TIM8_UP_IRQn, 3); 
		NVIC_EnableIRQ(TIM8_UP_IRQn);
		

}


void GPIO_Config(void)
{

//port A
	ALT_SET_REG(GPIOA, Pin0, IO_OUT_HS);
	GPIOA->AFR[0]=(GPIOA->AFR[0] & ~(0xFu<<(Pin0*4))) | (GPIO_AFR_AF8<<(Pin0*4)); //UART4 TX
	ALT_SET_REG(GPIOA, Pin1, IO_OUT_HS);
	GPIOA->AFR[0]=(GPIOA->AFR[0] & ~(0xFu<<(Pin1*4))) | (GPIO_AFR_AF8<<(Pin1*4));	//UART4 RX

	ALT_SET_REG(GPIOA, Pin2, IO_OUT_HS);
	GPIOA->AFR[0]=(GPIOA->AFR[0] & ~(0xFu<<(Pin2*4))) | (GPIO_AFR_AF10<<(Pin2*4)); //QUADSPI_NCS
	
	IN_SET_REG(GPIOA, Pin3, IO_IN_PU);	//INT Pin (FT8xx)
	OUT_SET_REG_WITH_TYPE(GPIOA, Pin4, IO_OD, IO_OUT_HS); //Power Down Pin (FT8xx)

	OUT_SET_REG_WITH_TYPE(GPIOA, Pin5, IO_OD, IO_OUT_HS);
	OUT_SET_REG_WITH_TYPE(GPIOA, Pin6, IO_PP, IO_OUT_HS);	
	OUT_SET_REG_WITH_TYPE(GPIOA, Pin7, IO_PP, IO_OUT_HS);	

	OUT_SET_REG_WITH_TYPE(GPIOA, Pin8, IO_PP, IO_OUT_HS);		//buzzer
	
	ALT_SET_REG(GPIOA, Pin9, IO_OUT_HS);
	GPIOA->AFR[1]=(GPIOA->AFR[1] & ~(0xFu<<(Pin9-8)*4)) | (GPIO_AFR_AF7<<((Pin9-8)*4)); //USART1 TX
	ALT_SET_REG(GPIOA, Pin10, IO_OUT_HS);
	GPIOA->AFR[1]=(GPIOA->AFR[1] & ~(0xFu<<((Pin10-8)*4))) | (GPIO_AFR_AF7<<((Pin10-8)*4));	//USART1 RX

	OUT_SET_REG_WITH_TYPE(GPIOA, Pin13, IO_PP, IO_OUT_HS);		//LED1
	OUT_SET_REG_WITH_TYPE(GPIOA, Pin14, IO_PP, IO_OUT_HS);		//LED2
	OUT_SET_REG_WITH_TYPE(GPIOA, Pin15, IO_OD, IO_OUT_HS);	//OTG_FS_PWR_ENABLE

//port B
	OUT_SET_REG_WITH_TYPE(GPIOB, Pin0, IO_PP, IO_OUT_HS);
	OUT_SET_REG_WITH_TYPE(GPIOB, Pin1, IO_PP, IO_OUT_HS);
	OUT_SET_REG_WITH_TYPE(GPIOB, Pin2, IO_PP, IO_OUT_HS);
	
	IN_SET_REG(GPIOB, Pin3, IO_IN_NPUD);
	IN_SET_REG(GPIOB, Pin4, IO_IN_NPUD);
	IN_SET_REG(GPIOB, Pin5, IO_IN_NPUD);
	IN_SET_REG(GPIOB, Pin6, IO_IN_NPUD);
	IN_SET_REG(GPIOB, Pin7, IO_IN_NPUD);
	IN_SET_REG(GPIOB, Pin8, IO_IN_NPUD);	
	IN_SET_REG(GPIOB, Pin9, IO_IN_NPUD);

	OUT_SET_REG_WITH_TYPE(GPIOB, Pin10, IO_PP, IO_OUT_HS);
	OUT_SET_REG_WITH_TYPE(GPIOB, Pin11, IO_PP, IO_OUT_HS);
	OUT_SET_REG_WITH_TYPE(GPIOB, Pin12, IO_PP, IO_OUT_HS);
	OUT_SET_REG_WITH_TYPE(GPIOB, Pin13, IO_PP, IO_OUT_HS);
	OUT_SET_REG_WITH_TYPE(GPIOB, Pin14, IO_PP, IO_OUT_HS);
	OUT_SET_REG_WITH_TYPE(GPIOB, Pin15, IO_PP, IO_OUT_HS);


//port C
	IN_SET_REG(GPIOC, Pin0, IO_IN_NPUD);
	IN_SET_REG(GPIOC, Pin1, IO_IN_NPUD);
	IN_SET_REG(GPIOC, Pin2, IO_IN_NPUD);
	IN_SET_REG(GPIOC, Pin3, IO_IN_NPUD);
	
	ALT_SET_REG(GPIOC, Pin4, IO_OUT_HS);
	GPIOC->AFR[0]=(GPIOC->AFR[0] & ~(0xFu<<(Pin4*4))) | (GPIO_AFR_AF7<<(Pin4*4)); //UART3 TX
	ALT_SET_REG(GPIOC, Pin5, IO_OUT_HS);
	GPIOC->AFR[0]=(GPIOC->AFR[0] & ~(0xFu<<(Pin5*4))) | (GPIO_AFR_AF7<<(Pin5*4));	//UART3 RX
	

	IN_SET_REG(GPIOC, Pin6, IO_IN_NPUD);
	IN_SET_REG(GPIOC, Pin7, IO_IN_NPUD);
	IN_SET_REG(GPIOC, Pin8, IO_IN_NPUD);		
	IN_SET_REG(GPIOC, Pin9, IO_IN_NPUD);
	IN_SET_REG(GPIOC, Pin10, IO_IN_NPUD);
	IN_SET_REG(GPIOC, Pin11, IO_IN_NPUD);
	IN_SET_REG(GPIOC, Pin12, IO_IN_NPUD); //OTG_FS_PWR_FAULT
	IN_SET_REG(GPIOC, Pin13, IO_IN_NPUD);			

//port D
	OUT_SET_REG_WITH_TYPE(GPIOD, Pin0, IO_PP, IO_OUT_HS);	
	OUT_SET_REG_WITH_TYPE(GPIOD, Pin1, IO_PP, IO_OUT_HS);
	OUT_SET_REG_WITH_TYPE(GPIOD, Pin2, IO_PP, IO_OUT_HS);
	OUT_SET_REG_WITH_TYPE(GPIOD, Pin3, IO_PP, IO_OUT_HS);
	OUT_SET_REG_WITH_TYPE(GPIOD, Pin4, IO_PP, IO_OUT_HS);
	OUT_SET_REG_WITH_TYPE(GPIOD, Pin5, IO_PP, IO_OUT_HS);
	OUT_SET_REG_WITH_TYPE(GPIOD, Pin6, IO_PP, IO_OUT_HS);
	OUT_SET_REG_WITH_TYPE(GPIOD, Pin7, IO_PP, IO_OUT_HS);
	OUT_SET_REG_WITH_TYPE(GPIOD, Pin8, IO_PP, IO_OUT_HS);
	OUT_SET_REG_WITH_TYPE(GPIOD, Pin9, IO_PP, IO_OUT_HS);
	OUT_SET_REG_WITH_TYPE(GPIOD, Pin10, IO_PP, IO_OUT_HS);
	OUT_SET_REG_WITH_TYPE(GPIOD, Pin11, IO_PP, IO_OUT_HS);
	OUT_SET_REG_WITH_TYPE(GPIOD, Pin12, IO_PP, IO_OUT_HS);
	OUT_SET_REG_WITH_TYPE(GPIOD, Pin13, IO_PP, IO_OUT_HS);
	OUT_SET_REG_WITH_TYPE(GPIOD, Pin14, IO_PP, IO_OUT_HS);
	OUT_SET_REG_WITH_TYPE(GPIOD, Pin15, IO_PP, IO_OUT_HS);

//port E
	OUT_SET_REG_WITH_TYPE(GPIOE, Pin0, IO_PP, IO_OUT_HS);	
	OUT_SET_REG_WITH_TYPE(GPIOE, Pin1, IO_PP, IO_OUT_HS);
	OUT_SET_REG_WITH_TYPE(GPIOE, Pin2, IO_PP, IO_OUT_HS);
	OUT_SET_REG_WITH_TYPE(GPIOE, Pin3, IO_PP, IO_OUT_HS);
	OUT_SET_REG_WITH_TYPE(GPIOE, Pin4, IO_PP, IO_OUT_HS);
	OUT_SET_REG_WITH_TYPE(GPIOE, Pin5, IO_PP, IO_OUT_HS);
	OUT_SET_REG_WITH_TYPE(GPIOE, Pin6, IO_PP, IO_OUT_HS);
	OUT_SET_REG_WITH_TYPE(GPIOE, Pin7, IO_PP, IO_OUT_HS);
	OUT_SET_REG_WITH_TYPE(GPIOE, Pin8, IO_PP, IO_OUT_HS);
	OUT_SET_REG_WITH_TYPE(GPIOE, Pin9, IO_PP, IO_OUT_HS);
	OUT_SET_REG_WITH_TYPE(GPIOE, Pin10, IO_PP, IO_OUT_HS);
	OUT_SET_REG_WITH_TYPE(GPIOE, Pin11, IO_PP, IO_OUT_HS);
	OUT_SET_REG_WITH_TYPE(GPIOE, Pin12, IO_PP, IO_OUT_HS);
	OUT_SET_REG_WITH_TYPE(GPIOE, Pin13, IO_PP, IO_OUT_HS);
	OUT_SET_REG_WITH_TYPE(GPIOE, Pin14, IO_PP, IO_OUT_HS);
	OUT_SET_REG_WITH_TYPE(GPIOE, Pin15, IO_PP, IO_OUT_HS);

//port F
	OUT_SET_REG_WITH_TYPE(GPIOF, Pin0, IO_PP, IO_OUT_HS);	
	OUT_SET_REG_WITH_TYPE(GPIOF, Pin1, IO_PP, IO_OUT_HS);
	OUT_SET_REG_WITH_TYPE(GPIOF, Pin2, IO_PP, IO_OUT_HS);
	OUT_SET_REG_WITH_TYPE(GPIOF, Pin3, IO_PP, IO_OUT_HS);
	OUT_SET_REG_WITH_TYPE(GPIOF, Pin4, IO_PP, IO_OUT_HS);
	OUT_SET_REG_WITH_TYPE(GPIOF, Pin5, IO_PP, IO_OUT_HS);
	
	ALT_SET_REG(GPIOF, Pin6, IO_OUT_HS);
	GPIOF->AFR[0]=(GPIOF->AFR[0] & ~(0xFu<<(Pin6*4))) | (GPIO_AFR_AF10<<(Pin6*4)); //QUADSPI_IO3
	ALT_SET_REG(GPIOF, Pin7, IO_OUT_HS);
	GPIOF->AFR[0]=(GPIOF->AFR[0] & ~(0xFu<<(Pin7*4))) | (GPIO_AFR_AF10<<(Pin7*4)); //QUADSPI_IO2
	ALT_SET_REG(GPIOF, Pin8, IO_OUT_HS);
	GPIOF->AFR[1]=(GPIOF->AFR[1] & ~(0xFu<<(Pin8-8)*4)) | (GPIO_AFR_AF10<<((Pin8-8)*4)); //QUADSPI_IO0
	ALT_SET_REG(GPIOF, Pin9, IO_OUT_HS);
	GPIOF->AFR[1]=(GPIOF->AFR[1] & ~(0xFu<<(Pin9-8)*4)) | (GPIO_AFR_AF10<<((Pin9-8)*4)); //QUADSPI_IO1
	ALT_SET_REG(GPIOF, Pin10, IO_OUT_HS);
	GPIOF->AFR[1]=(GPIOF->AFR[1] & ~(0xFu<<(Pin10-8)*4)) | (GPIO_AFR_AF3<<((Pin10-8)*4)); //QUADSPI_CLK
	
	OUT_SET_REG_WITH_TYPE(GPIOF, Pin11, IO_PP, IO_OUT_HS);
	OUT_SET_REG_WITH_TYPE(GPIOF, Pin12, IO_PP, IO_OUT_HS);
	OUT_SET_REG_WITH_TYPE(GPIOF, Pin13, IO_PP, IO_OUT_HS);
	OUT_SET_REG_WITH_TYPE(GPIOF, Pin14, IO_PP, IO_OUT_HS);
	OUT_SET_REG_WITH_TYPE(GPIOF, Pin15, IO_OD, IO_OUT_HS);

//port G
	OUT_SET_REG_WITH_TYPE(GPIOG, Pin0, IO_PP, IO_OUT_HS);	
	OUT_SET_REG_WITH_TYPE(GPIOG, Pin1, IO_PP, IO_OUT_HS);
	OUT_SET_REG_WITH_TYPE(GPIOG, Pin2, IO_PP, IO_OUT_HS);
	OUT_SET_REG_WITH_TYPE(GPIOG, Pin3, IO_PP, IO_OUT_HS);
	OUT_SET_REG_WITH_TYPE(GPIOG, Pin4, IO_PP, IO_OUT_HS);
	OUT_SET_REG_WITH_TYPE(GPIOG, Pin5, IO_PP, IO_OUT_HS);
	OUT_SET_REG_WITH_TYPE(GPIOG, Pin6, IO_PP, IO_OUT_HS);
	OUT_SET_REG_WITH_TYPE(GPIOG, Pin7, IO_PP, IO_OUT_HS);
	OUT_SET_REG_WITH_TYPE(GPIOG, Pin8, IO_PP, IO_OUT_HS);
	OUT_SET_REG_WITH_TYPE(GPIOG, Pin9, IO_PP, IO_OUT_HS);
	OUT_SET_REG_WITH_TYPE(GPIOG, Pin10, IO_PP, IO_OUT_HS);
	OUT_SET_REG_WITH_TYPE(GPIOG, Pin11, IO_PP, IO_OUT_HS);
	OUT_SET_REG_WITH_TYPE(GPIOG, Pin12, IO_PP, IO_OUT_HS);
	OUT_SET_REG_WITH_TYPE(GPIOG, Pin13, IO_PP, IO_OUT_HS);
	OUT_SET_REG_WITH_TYPE(GPIOG, Pin14, IO_PP, IO_OUT_HS);
	OUT_SET_REG_WITH_TYPE(GPIOG, Pin15, IO_PP, IO_OUT_HS);



	PIN_SET(LED_PORT, LED1);
	PIN_CLR(LED_PORT, LED2);

	PIN_SET(PORT_TFT, PIN_TFT_PD);
}


void TIM_Config(void){
	unsigned int APB2ClockFreq=SystemCoreClock>>APBPrescTable[((RCC->CFGR & RCC_CFGR_PPRE2) >> 11U)];
	unsigned int APB1ClockFreq=SystemCoreClock>>APBPrescTable[((RCC->CFGR & RCC_CFGR_PPRE1) >> 8U)];


	TIM5->CR1&=~TIM_CR1_DIR;  
	TIM5->CR1&=~TIM_CR1_CMS;  
	TIM5->PSC=1000-1;	
	TIM5->ARR=((APB1ClockFreq/(TIM5->PSC+1))/BASE_FREQUENCY_OF_TIM5)-1;	
  TIM5->EGR = TIM_EGR_UG;  
	
	TIM5->DIER &= ~TIM_DIER_UIE;					
	TIM5->CR1 &= ~TIM_CR1_CEN;
//--------------------------------------------------------------------------

	TIM8->CR1&=~TIM_CR1_DIR;  
	TIM8->CR1&=~TIM_CR1_CMS;  
	TIM8->PSC=10000-1;	
	TIM8->ARR=((APB2ClockFreq/(TIM8->PSC+1))/BASE_FREQUENCY_OF_TIM8)-1;		
  TIM8->EGR = TIM_EGR_UG;  

	TIM8->DIER &= ~TIM_DIER_UIE;
	TIM8->CR1 &= ~TIM_CR1_CEN;	
//--------------------------------------------------------------------------
}


void OCTOSPI_Config(void){
	
	RCC->CCIPR2 &=~ RCC_CCIPR2_OSPISEL;

	OCTOSPI1->CR&=~OCTOSPI_CR_FSEL;		//Flash select: FLASH 1 selected
	OCTOSPI1->CR&=~OCTOSPI_CR_DQM;		//Dual-memory configuration: Dual-quad configuration disabled
	OCTOSPI1->CR=(OCTOSPI1->CR & ~OCTOSPI_CR_FTHRES) | (3<<OCTOSPI_CR_FTHRES_Pos);	//FIFO threshold level
	OCTOSPI1->CR = (OCTOSPI1->CR & ~OCTOSPI_CR_FMODE);			

	OCTOSPI1->DCR1=(OCTOSPI1->DCR1 & ~OCTOSPI_DCR1_DEVSIZE) | (31<<OCTOSPI_DCR1_DEVSIZE_Pos);
	OCTOSPI1->DCR1&=~OCTOSPI_DCR1_CSHT;
	OCTOSPI1->DCR1&=~OCTOSPI_DCR1_CKMODE;
	OCTOSPI1->DCR1=(OCTOSPI1->DCR1 & ~OCTOSPI_DCR1_MTYP) | OCTOSPI_DCR1_MTYP_1;	
	
	OCTOSPI1->DCR2=(OCTOSPI1->DCR2 & ~OCTOSPI_DCR2_PRESCALER) | (21<<OCTOSPI_DCR2_PRESCALER_Pos);	//Clock prescaler: set 6MHz 

	OCTOSPI1->TCR = (OCTOSPI1->TCR & ~OCTOSPI_TCR_DCYC);			

	OCTOSPI1->CCR = (OCTOSPI1->CCR & ~OCTOSPI_CCR_IMODE);			
	OCTOSPI1->CCR = (OCTOSPI1->CCR & ~OCTOSPI_CCR_ADSIZE) | OCTOSPI_CCR_ADSIZE_1;  	
	OCTOSPI1->CCR = (OCTOSPI1->CCR & ~OCTOSPI_CCR_ADMODE);		
	OCTOSPI1->CCR = (OCTOSPI1->CCR & ~OCTOSPI_CCR_ABMODE);		
	OCTOSPI1->CCR = (OCTOSPI1->CCR & ~OCTOSPI_CCR_DMODE);			

}